AUTOSAR XML (schema 4-0-3)
package /Ecuc
  module config Os: ecuc-def-edition=4.2.0, implementation-config-variant=VARIANT-PRE-COMPILE
    7 x OsTask, all with OsTaskActivation=1, OsTaskStackSize=512, OsTaskSchedule=FULL, OsTaskEventRef=AutosarOsExtEvent:
      AutosarOsTaskTestControl: OsTaskPriority=4
        OsTaskAutostart: OsTaskAppModeRef=AppMode1
      AutosarOsTaskTestSupplier1: OsTaskPriority=4
      AutosarOsTaskTestSupplier2: OsTaskPriority=9
      AutosarOsTaskTestSupplier3: OsTaskPriority=11
      AutosarOsTaskTestConsumer1: OsTaskPriority=4
      AutosarOsTaskTestConsumer2: OsTaskPriority=9
      AutosarOsTaskTestConsumer3: OsTaskPriority=11
    AutosarOsTaskTestCyclicHandler (OsAlarm): OsAlarmCounterRef=MAIN_HW_COUNTER
      OsAlarmAction
        OsAlarmCallback: OsAlarmCallbackName=AutosarOsTestCyclicHandler
      OsAlarmAutostart: OsAlarmAlarmTime=10000, OsAlarmCycleTime=1000, OsAlarmAutostartType=ABSOLUTE, OsAlarmAppModeRef=AppMode1
